## base_external/package/ldd/Config.in
```kconfig
config BR2_PACKAGE_LDD
	bool "ldd"
	help
	  Builds and installs the scull and misc-modules (hello, faulty)
	  kernel modules from the ldd3 repository onto the target.
```
